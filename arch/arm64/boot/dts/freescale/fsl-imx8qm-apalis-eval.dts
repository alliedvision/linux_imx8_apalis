// SPDX-License-Identifier: GPL-2.0+ OR X11
/*
 * Copyright 2019 Toradex
 */

/dts-v1/;

#include "fsl-imx8qm-apalis.dtsi"
#include "fsl-imx8qm-apalis-eval.dtsi"

/ {
	model = "Toradex Apalis iMX8QM/QP on Apalis Evaluation Board";
	compatible = "toradex,apalis-imx8qm-eval", "toradex,apalis-imx8qm", "fsl,imx8qm";
};