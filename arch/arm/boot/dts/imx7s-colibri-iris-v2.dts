/*
 * Copyright 2017 Toradex AG
 *
 * This program is free software; you can redistribute it and/or modify
 * it under the terms of the GNU General Public License as published by
 * the Free Software Foundation; either version 2 of the License, or
 * (at your option) any later version.
 */

/dts-v1/;
#include "imx7s-colibri.dtsi"
#include "imx7-colibri-iris-v2.dtsi"

/ {
	model = "Toradex Colibri iMX7S on Colibri Iris V2 Board";
	compatible = "toradex,colibri_imx7s-iris-v2", \
			"toradex,colibri_imx7s", "fsl,imx7s", "fsl,imx7d";
};
